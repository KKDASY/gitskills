#include "bsp_crc.h"

extern CRC_HandleTypeDef hcrc;
/**
* 用于CRC校验
* 1.输入数据按字节反转
* 2.CRC初始值为0xFFFF
* 3.用0x8005做除数
* 4.输出数据结果整体反转
*/
void HW_CRC_Init(void)
{
  //指定CRC外设实例（STM32通常只有一个CRC硬件模块）
  hcrc.Instance = CRC;
  //禁用默认多项式（使用自定义的多项式）
	hcrc.Init.DefaultPolynomialUse = DEFAULT_POLYNOMIAL_DISABLE;
  //禁用默认初始值（使用自定义初始值）
	hcrc.Init.DefaultInitValueUse = DEFAULT_INIT_VALUE_DISABLE;
  //设置多项式位0x8005（Modbus标准CRC-16多项式）  对应x^16 + x^15 + x^2 + 1
	hcrc.Init.GeneratingPolynomial = 0x8005;    //CRC polynomial for MODBUS
	//设置CRC长度为16位
  hcrc.Init.CRCLength = CRC_POLYLENGTH_16B;
  //设置初始值为0xFFFF（Modebus标准初始值）
	hcrc.Init.InitValue = 0xffff;
  //设置输入数据按字节反转（Modbus要求每个字节进行位反转）
	hcrc.Init.InputDataInversionMode = CRC_INPUTDATA_INVERSION_BYTE;
  //使能输出结果整体反转（Modbus要求最终CRC结果进行位反转）
	hcrc.Init.OutputDataInversionMode = CRC_OUTPUTDATA_INVERSION_ENABLE;
  //设置输入数据格式为字节（按字节处理）
	hcrc.InputDataFormat = CRC_INPUTDATA_FORMAT_BYTES;
  //初始化CRC硬件模块，如果失败调用错误处理函数
	if (HAL_CRC_Init(&hcrc) != HAL_OK)
	{
		Error_Handler();
	}
}

uint16_t Get_CRC16_MODBUS(const uint8_t *data, uint16_t len)
{
    uint16_t crc = 0xFFFF;
    for(uint16_t i = 0; i < len; i++) 
    {
        crc ^= (uint16_t)data[i];
        for(int j = 0; j < 8; j++) 
        {
            if(crc & 0x0001) {
                crc = (crc >> 1) ^ 0xA001;  // 0x8005的反转
            } else {
                crc = crc >> 1;
            }
        }
    }
    return crc;
} 

static unsigned short CRC16_CCITT(unsigned char *pdata, unsigned int len)
{
    const static unsigned short CRC16_CCITT_Tab[256] =
    {
        0x0000, 0x1189, 0x2312, 0x329b, 0x4624, 0x57ad, 0x6536, 0x74bf,
        0x8c48, 0x9dc1, 0xaf5a, 0xbed3, 0xca6c, 0xdbe5, 0xe97e, 0xf8f7,
        0x1081, 0x0108, 0x3393, 0x221a, 0x56a5, 0x472c, 0x75b7, 0x643e,
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        0x7bc7, 0x6a4e, 0x58d5, 0x495c, 0x3de3, 0x2c6a, 0x1ef1, 0x0f78
    };

    unsigned short crc = 0x0000;
    while (len--)
        crc = (crc >> 8) ^ CRC16_CCITT_Tab[(crc ^ *pdata++) & 0xff];
    return crc; 
}

uint16_t cal_crc16_ccitt(const uint8_t *data, uint16_t length)
{
    return CRC16_CCITT((unsigned char*)data, length);
}






